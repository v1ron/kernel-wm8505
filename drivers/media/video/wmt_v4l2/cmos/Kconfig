## drivers/media/video/wmt_v4l2/cmos/Kconfig
```kconfig
#
# Multimedia Video device configuration
#

config WMT_V4L2_CMOS
	tristate "WonderMedia Hardware CMOS Support"
	---help---
	  Say Y here to use hardware CMOS Support	
  

 	
```

## drivers/staging/rt2870/Kconfig
```kconfig
config RT2870
	tristate "Ralink 2870 wireless support"
	depends on USB && X86 && WLAN_802111
	---help---
	  This is an experimental driver for the Ralink 2870 wireless chip.
```

## sound/arm/Kconfig
```kconfig
# ALSA ARM drivers

menuconfig SND_ARM
	bool "ARM sound devices"
	depends on ARM
	default y
	help
	  Support for sound devices specific to ARM architectures.
	  Drivers that are implemented on ASoC can be found in
	  "ALSA for SoC audio support" section.

if SND_ARM

config SND_SA11XX_UDA1341
	tristate "SA11xx UDA1341TS driver (iPaq H3600)"
	depends on ARCH_SA1100 && L3
	select SND_PCM
	help
	  Say Y here if you have a Compaq iPaq H3x00 handheld computer
	  and want to use its Philips UDA 1341 audio chip.

	  To compile this driver as a module, choose M here: the module
	  will be called snd-sa11xx-uda1341.

config SND_ARMAACI
	tristate "ARM PrimeCell PL041 AC Link support"
	depends on ARM_AMBA
	select SND_PCM
	select SND_AC97_CODEC

config SND_PXA2XX_PCM
	tristate
	select SND_PCM

config SND_PXA2XX_LIB
	tristate
	select SND_AC97_CODEC if SND_PXA2XX_LIB_AC97

config SND_PXA2XX_LIB_AC97
	bool

config SND_PXA2XX_AC97
	tristate "AC97 driver for the Intel PXA2xx chip"
	depends on ARCH_PXA
	select SND_PXA2XX_PCM
	select SND_AC97_CODEC
	select SND_PXA2XX_LIB
	select SND_PXA2XX_LIB_AC97
	help
	  Say Y or M if you want to support any AC97 codec attached to
	  the PXA2xx AC97 interface.

config SOUND_WMT_I2S
        tristate "WMT I2S Sound Driver"
        depends on SOUND && ARCH_WMT
        ---help---
          Say Y here if you want to use the I2S sound driver on WMT EVB based
          EVB.
choice
    prompt "I2S Codec Select"
        depends on SOUND_WMT_I2S
    default  I2S_Codec_VT1602
config I2S_Codec_VT1602
        bool "VT1602"
        ---help---
          Say Y here if you want to use VT1602 as the I2S Codec.
endchoice          
#
# VIA1613 CODEC driver
#
config SOUND_WMT_AC97
        tristate "WMT AC'97 Sound Driver"
        depends on SOUND && ARCH_WMT
        ---help---
          Say Y here if you want to use the AC'97 sound driver on WMT based
          EVB.

choice
    prompt "AC97 Codec Select"
        depends on SOUND_WMT_AC97
    default WMT_VT1613 
config WMT_VT1613
        bool "VT1613 function support"
        depends on SOUND && ARCH_WMT && SOUND_WMT_AC97
        ---help---
          Say Y here if you are using the WMT with VIA1613 function support.
endchoice          

endif	# SND_ARM
```

## sound/soc/wmt/Kconfig
```kconfig
config SND_WMT_AC97
	tristate "AC97 Audio for the WMT chip"
	depends on ARCH_WMT && SND
	help
	  Say Y or M if you want to add support for codecs attached to
	  the WMT AC97 interface. You will also need to select the audio 
	  interfaces to support below.

config SND_WMT_I2S
	tristate "I2S Audio for the WMT chip"
	depends on ARCH_WMT && SND
	help
	  Say Y or M if you want to add support for codecs attached to
	  the WMT I2S interface. You will also need to select the audio 
	  interfaces to support below.

choice
	prompt "I2S CODEC select"
	default SND_WMT_I2S_ES8328

config SND_WMT_I2S_ES8328
	bool "Everest Semiconductor ES8328"
	help
	    Everest Semiconductor ES8328 chip. This CODEC is used in
	    YaZhongX EPC Chinese WM8505 netbook.

config SND_WMT_I2S_VT1602
	bool "VIA VT1602"
	help
	    VIA VT1602. I don't have a machine with this one, this driver
	    is untested.

endchoice
```
